#include <ESP8266WiFi.h>
#include <WiFiClient.h>
#include <Arduino.h>
#include <WiFiClient.h>
#include <WiFiServer.h>
#include <ESP8266WebServer.h>
#include <DNSServer.h>
#include <WiFiUdp.h>
#include <StreamString.h>
#include "version.h"
#define emptyString String()

////////////////////// Change Paramter to your choosing /////////////////////////
/////////////// Do not change any parameters above this line ////////////////////

#define HOSTNAME "UpdateESP8266"    // AP name will be HOSTNAME-XXXXXX, where XXXXXX are CHIP_ID
#define HTTP_USER ""                // Set any username for update authentication, default empty
#define HTTP_PASSWORD ""            // Set any password for update authentication, default empty
IPAddress apIP(192, 168, 4, 1);     // AP IP: http://192.168.4.1/update
bool SERIAL_OUTPUT = true;          // If Serial output is desired

//Enter values for SSID and corresponing password
String WIFI_SSID = ""; //Enter SSID
String WIFI_PASS = ""; //Enter SSID
/////////////// Do not change any parameters below this line ////////////////////
/////////////////////////////////////////////////////////////////////////////////

#define HTTP_PORT 80
#define HTTP_UPDATE_PATH "/update"
const byte DNS_PORT = 53;
bool authenticated = false;
String updaterError;
String username = HTTP_USER;
String password = HTTP_PASSWORD;

/* //uncompressed size: 3879
static const char update_htm[] PROGMEM = R"=====(
<!DOCTYPE html><html><meta http-equiv="Content-Type" content="text/html; charset=utf-8"><meta name="viewport" content="width=device-width,initial-scale=0.5"><head><style>#fileLabelText,#uploadStatus{font-family:Arial,Helvetica,sans-serif}body{margin:0;height:100vh;display:flex;flex-direction:column;justify-content:center;background-color:#95b195}#dropFileForm{margin:auto 100px;text-align:center;border-radius:8px;overflow:hidden;transition:.5s}#dropFileForm #fileLabel{background-color:rgba(0,255,0,.5);display:block;padding:24px;position:relative;cursor:pointer}#dropFileForm #fileInput{display:none}#dropFileForm #fileLabel:after,#dropFileForm #fileLabel:before{position:absolute;content:"";top:0;bottom:0;left:0;right:0;background-color:#fff;z-index:-2;border-radius:8px 8px 0 0}#dropFileForm #fileLabel:before{z-index:-1;background:repeating-linear-gradient(45deg,transparent,transparent 5%,#000 5%,#000 10%);opacity:0;transition:.5s}#dropFileForm.fileHover #fileLabel:before{opacity:.25}#dropFileForm .uploadButton{border:0;outline:0;width:100%;padding:8px;font-size:50px;background-color:#32cd32;color:#fff;cursor:pointer}#dropFileForm.fileHover{box-shadow:0 0 16px #32cd32}#fileLabelText{color:#000;font-size:40px}#uploadStatus{color:#700000;font-size:30px}</style></head><body><form id="dropFileForm" action="/update" method="post" onsubmit="uploadFiles(event)"><input type="file" name="files[]" id="fileInput" onchange="addFiles(event)" accept=".bin"><label for="fileInput" id="fileLabel" ondragover="overrideDefault(event),fileHover()" ondragenter="overrideDefault(event),fileHover()" ondragleave="overrideDefault(event),fileHoverEnd()" ondrop="overrideDefault(event),fileHoverEnd(),addFiles(event)"><svg width="350" height="350" viewBox="0 0 2048 1792" xmlns="http://www.w3.org/2000/svg"><path d="M1344 864q0-14-9-23l-352-352q-9-9-23-9t-23 9l-351 351q-10 12-10 24 0 14 9 23t23 9h224v352q0 13 9.5 22.5t22.5 9.5h192q13 0 22.5-9.5t9.5-22.5v-352h224q13 0 22.5-9.5t9.5-22.5zm640 288q0 159-112.5 271.5t-271.5 112.5h-1088q-185 0-316.5-131.5t-131.5-316.5q0-130 70-240t188-165q-2-30-2-43 0-212 150-362t362-150q156 0 285.5 87t188.5 231q71-62 166-62 106 0 181 75t75 181q0 76-41 138 130 31 213.5 135.5t83.5 238.5z"/></svg><br><span id="fileLabelText">Choose firmware.bin or drag it here</span><br><span id="uploadStatus"></span></label><input type="submit" value="Update Firmware" class="uploadButton"></form><script>function overrideDefault(e){e.preventDefault(),e.stopPropagation()}function fileHover(){dropFileForm.classList.add("fileHover")}function fileHoverEnd(){dropFileForm.classList.remove("fileHover")}function addFiles(e){droppedFiles=e.target.files||e.dataTransfer.files,showFiles(droppedFiles)}function showFiles(e){"bin"!=e[0].name.split(".").pop()?(fileLabelText.innerText="STOP: Only choose .bin file !!!",alert("STOP: Only choose .bin file !!!"),fileInput.value="",dropFileForm.reset()):fileLabelText.innerText=e[0].name}function uploadFiles(e){if(e.preventDefault(),0==fileInput.files.length)fileLabelText.innerText="Select at least 1 file!";else{changeStatus("Uploading...");var t=new FormData;t.append(fileInput.name,droppedFiles[0],droppedFiles[0].name),fetch(dropFileForm.action,{method:dropFileForm.method,body:t}).then(function(e){if(e.ok)return e.text();throw new Error("Network response was not ok.")}).then(function(e){changeStatus(e+", reload in 30s!"),console.log(e),setTimeout(function(){location.reload()},3e4)}).catch(function(e){changeStatus("Error: "+e.message),console.log("Error: ",e.message),setTimeout(function(){location.reload()},5e3)})}}function changeStatus(e){uploadStatus.innerText=e}var dropFileForm=document.getElementById("dropFileForm"),fileLabelText=document.getElementById("fileLabelText"),uploadStatus=document.getElementById("uploadStatus"),fileInput=document.getElementById("fileInput"),droppedFiles</script></body></html>)=====";
*/

//gz size: 1721
#define update_htm_gz_len 1738
static const char update_htm_gz[] PROGMEM = {
  0x1f, 0x8b, 0x08, 0x08, 0xba, 0x80, 0x3d, 0x5c, 0x04, 0x00, 0x69, 0x6e,
  0x64, 0x65, 0x78, 0x2e, 0x6d, 0x69, 0x6e, 0x2e, 0x68, 0x74, 0x6d, 0x00,
  0x95, 0x57, 0x59, 0x13, 0x93, 0x30, 0x10, 0xfe, 0x2b, 0x11, 0xc7, 0x99,
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  0xe1, 0x1f, 0x78, 0x62, 0xe0, 0x81, 0x25, 0x0f, 0x00, 0x00 
};

ESP8266WebServer server(HTTP_PORT);
DNSServer dns;

void setUpdaterError()
{
    if (SERIAL_OUTPUT)
        Update.printError(Serial);
    StreamString str;
    Update.printError(str);
    updaterError = str.c_str();
}

void handleRedirect()
{ 
    server.sendHeader("Location", "/update", true);
    server.send(302, "text/plain", ""); 
}

void setup(void)
{
    char NameChipId[64] = {0};
    snprintf(NameChipId, sizeof(NameChipId), "%s-%06x", HOSTNAME, ESP.getChipId());
    if (SERIAL_OUTPUT)
    {
        Serial.begin(115200);
        Serial.println();
        Serial.println("Booting Sketch...");
    }
    WiFi.hostname(NameChipId);
    if (!WIFI_SSID.length()){
      WiFi.mode(WIFI_AP);
    }else{
      WiFi.mode(WIFI_AP_STA);
      WiFi.begin(WIFI_SSID.c_str(), WIFI_PASS.c_str());
      if (SERIAL_OUTPUT) Serial.printf("Connecting to %s ", WIFI_SSID.c_str());
      while (WiFi.status() != WL_CONNECTED)
      {
        if (SERIAL_OUTPUT) Serial.print(".");
        delay(1000);
      }
      if (SERIAL_OUTPUT){
        Serial.println(" connected!");
        Serial.print("Router IP: ");
        Serial.println(WiFi.localIP());
      }
    }
    WiFi.softAPConfig(apIP, apIP, IPAddress(255, 255, 255, 0));
    WiFi.softAP(NameChipId);
    if (SERIAL_OUTPUT)
    {
        Serial.print("HotSpt IP: ");
        Serial.println(WiFi.softAPIP());
    }
    dns.start(DNS_PORT, "*", WiFi.softAPIP());

    server.on("/", handleRedirect);
    server.on("/version", []() {
        server.send(200, "text/plain", SKETCH_VERSION);
    });
    // handler for the /update form page
    server.on(HTTP_UPDATE_PATH, HTTP_GET, [&]() {
        if (username != emptyString && password != emptyString && !server.authenticate(username.c_str(), password.c_str()))
            return server.requestAuthentication();
        // server.send_P(200, PSTR("text/html"), update_htm);
        server.sendHeader("Content-Encoding", "gzip", true);
        server.send_P(200, PSTR("text/html"), update_htm_gz, update_htm_gz_len);
    });

    // handler for the /update form POST (once file upload finishes)
    server.on(HTTP_UPDATE_PATH, HTTP_POST, [&]() {
      if(!authenticated)
        return server.requestAuthentication();
      if (Update.hasError()) {
        server.send(200, F("text/plain"), String(F("Update error: ")) + updaterError);
      } else {
        server.client().setNoDelay(true);
        server.send(200, PSTR("text/plain"), String(F("Update OK")));
        delay(100);
        server.client().stop();
        ESP.restart();
      } }, [&]() {
      // handler for the file upload, get's the sketch bytes, and writes
      // them through the Update object
      HTTPUpload& upload = server.upload();

      if(upload.status == UPLOAD_FILE_START){
        updaterError = String();
        if (SERIAL_OUTPUT)
          Serial.setDebugOutput(true);

        authenticated = (username == emptyString || password == emptyString || server.authenticate(username.c_str(), password.c_str()));
        if(!authenticated){
          if (SERIAL_OUTPUT)
            Serial.printf("Unauthenticated Update\n");
          return;
        }

        WiFiUDP::stopAll();
        if (SERIAL_OUTPUT)
          Serial.printf("Update: %s\n", upload.filename.c_str());
        uint32_t maxSketchSpace = (ESP.getFreeSketchSpace() - 0x1000) & 0xFFFFF000;
        if(!Update.begin(maxSketchSpace)){//start with max available size
          setUpdaterError();
        }
      } else if(authenticated && upload.status == UPLOAD_FILE_WRITE && !updaterError.length()){
        if (SERIAL_OUTPUT) Serial.printf(".");
        if(Update.write(upload.buf, upload.currentSize) != upload.currentSize){
          setUpdaterError();
        }
      } else if(authenticated && upload.status == UPLOAD_FILE_END && !updaterError.length()){
        if(Update.end(true)){ //true to set the size to the current progress
          if (SERIAL_OUTPUT) Serial.printf("\nUpdate Success: %u\nRebooting...\n", upload.totalSize);
        } else {
          setUpdaterError();
        }
        if (SERIAL_OUTPUT) Serial.setDebugOutput(false);
      } else if(authenticated && upload.status == UPLOAD_FILE_ABORTED){
        Update.end();
        if (SERIAL_OUTPUT) Serial.println("Update was aborted");
      }
      delay(0); });
    server.onNotFound(handleRedirect);
    server.begin();
}

void loop(void)
{
    server.handleClient();
    dns.processNextRequest();
}